## firmware/components/simcore_config/Kconfig
```kconfig
menu "SimCore"

config SIMCORE_DEBUG
    bool "Runtime performance diagnostics"
    default n
    select FREERTOS_GENERATE_RUN_TIME_STATS
    help
        Enables performance collection, transport diagnostics, and the
        on-screen performance overlay.

config SIMCORE_LAYOUT_DEBUG
    bool "Dashboard layout outlines"
    default n
    help
        Draws dashboard block and widget boundaries.

config SIMCORE_DISPLAY_DIAGNOSTICS
    bool "Full-screen display diagnostics"
    default n
    help
        Replaces configured widgets with the display hardware diagnostic UI.

choice SIMCORE_FACTORY_BOARD
    prompt "Factory board profile"
    default SIMCORE_FACTORY_BOARD_GUITION_JC1060P470C if IDF_TARGET_ESP32P4
    default SIMCORE_FACTORY_BOARD_T_DISPLAY_S3
    help
        Selects the immutable hardware identity and the fallback configuration
        used when neither NVS configuration slot is valid. All supported
        The P4 build links only its board drivers. ESP32-S3 keeps both board
        alternatives discoverable because ESP-IDF resolves component
        requirements before loading this choice on a fresh configure.

config SIMCORE_FACTORY_BOARD_T_DISPLAY_S3
    bool "LilyGO T-Display-S3"
    depends on IDF_TARGET_ESP32S3

config SIMCORE_FACTORY_BOARD_GUITION_ESP32_4848S040
    bool "Guition ESP32-4848S040"
    depends on IDF_TARGET_ESP32S3

config SIMCORE_FACTORY_BOARD_GUITION_JC1060P470C
    bool "Guition JC1060P470C"
    depends on IDF_TARGET_ESP32P4

endchoice

endmenu
```

## firmware/sdkconfig.defaults
```kconfig
CONFIG_ESPTOOLPY_FLASHSIZE_16MB=y
CONFIG_ESPTOOLPY_FLASHSIZE="16MB"
CONFIG_COMPILER_OPTIMIZATION_PERF=y
CONFIG_SPIRAM=y
CONFIG_SPIRAM_USE_MALLOC=y
CONFIG_SPIRAM_MALLOC_ALWAYSINTERNAL=16384
CONFIG_SPIRAM_MALLOC_RESERVE_INTERNAL=32768
CONFIG_SPIRAM_ALLOW_BSS_SEG_EXTERNAL_MEMORY=y
# CONFIG_LV_USE_BUILTIN_MALLOC is not set
# CONFIG_LV_USE_CLIB_MALLOC is not set
CONFIG_LV_USE_CUSTOM_MALLOC=y
CONFIG_LV_FONT_UNSCII_8=y
CONFIG_LV_FONT_DEFAULT_UNSCII_8=y
# CONFIG_LV_FONT_MONTSERRAT_14 is not set
CONFIG_LV_BUILD_EXAMPLES=n
CONFIG_LV_BUILD_DEMOS=n
CONFIG_LV_USE_VECTOR_GRAPHIC=n
CONFIG_LV_USE_THORVG=n
# CONFIG_LV_USE_FLOAT is not set
CONFIG_LV_USE_TINY_TTF=y
# CONFIG_LV_TINY_TTF_FILE_SUPPORT is not set
CONFIG_LV_TINY_TTF_CACHE_GLYPH_CNT=128
CONFIG_LV_TINY_TTF_CACHE_KERNING_CNT=0
CONFIG_LV_DEF_REFR_PERIOD=4
# CONFIG_LV_USE_THEME_DEFAULT is not set
# CONFIG_LV_USE_THEME_SIMPLE is not set
# CONFIG_LV_USE_THEME_MONO is not set
# CONFIG_LV_USE_ANIMIMG is not set
# CONFIG_LV_USE_ARCLABEL is not set
# CONFIG_LV_USE_BAR is not set
# CONFIG_LV_USE_BUTTON is not set
# CONFIG_LV_USE_BUTTONMATRIX is not set
# CONFIG_LV_USE_CALENDAR is not set
CONFIG_LV_USE_CANVAS=y
# CONFIG_LV_USE_CHART is not set
# CONFIG_LV_USE_CHECKBOX is not set
# CONFIG_LV_USE_DROPDOWN is not set
# CONFIG_LV_USE_IMAGEBUTTON is not set
# CONFIG_LV_USE_KEYBOARD is not set
# CONFIG_LV_USE_LED is not set
# CONFIG_LV_USE_LIST is not set
# CONFIG_LV_USE_MENU is not set
# CONFIG_LV_USE_MSGBOX is not set
# CONFIG_LV_USE_ROLLER is not set
# CONFIG_LV_USE_SCALE is not set
# CONFIG_LV_USE_SLIDER is not set
# CONFIG_LV_USE_SPAN is not set
# CONFIG_LV_USE_SPINBOX is not set
# CONFIG_LV_USE_SPINNER is not set
# CONFIG_LV_USE_SWITCH is not set
# CONFIG_LV_USE_TEXTAREA is not set
# CONFIG_LV_USE_TABLE is not set
# CONFIG_LV_USE_TABVIEW is not set
# CONFIG_LV_USE_TILEVIEW is not set
# CONFIG_LV_USE_WIN is not set
# CONFIG_LV_USE_FLEX is not set
# CONFIG_LV_USE_GRID is not set
# CONFIG_LV_USE_OBSERVER is not set
# CONFIG_LV_LABEL_TEXT_SELECTION is not set
CONFIG_FREERTOS_HZ=1000
CONFIG_ESP_MAIN_TASK_STACK_SIZE=5120
CONFIG_ESP_TASK_WDT_PANIC=y
CONFIG_ESP_TASK_WDT_TIMEOUT_S=10
# CONFIG_ESP_TASK_WDT_CHECK_IDLE_TASK_CPU0 is not set
# CONFIG_ESP_TASK_WDT_CHECK_IDLE_TASK_CPU1 is not set
CONFIG_UART_ISR_IN_IRAM=y
# CONFIG_FREERTOS_GENERATE_RUN_TIME_STATS is not set
CONFIG_LV_USE_SYSMON=n
CONFIG_TINYUSB_CDC_ENABLED=y
CONFIG_TINYUSB_DESC_MANUFACTURER_STRING="SimCore"
CONFIG_TINYUSB_DESC_PRODUCT_STRING="SimCore"
CONFIG_TINYUSB_DESC_CDC_STRING="SimCore CDC"
CONFIG_PARTITION_TABLE_CUSTOM=y
CONFIG_PARTITION_TABLE_CUSTOM_FILENAME="partitions.csv"
CONFIG_BOOTLOADER_APP_ROLLBACK_ENABLE=y
CONFIG_CJSON_NESTING_LIMIT=16
# CONFIG_SIMCORE_DEBUG is not set
# CONFIG_SIMCORE_LAYOUT_DEBUG is not set
```

## firmware/sdkconfig.defaults.color-24bit
```kconfig
CONFIG_SIMCORE_DISPLAY_COLOR_24BIT=y
CONFIG_LV_COLOR_DEPTH_24=y
# CONFIG_LV_COLOR_DEPTH_16 is not set
```

## firmware/sdkconfig.defaults.debug
```kconfig
CONFIG_PITRIG_DEBUG=y
CONFIG_FREERTOS_GENERATE_RUN_TIME_STATS=y
CONFIG_FREERTOS_RUN_TIME_COUNTER_TYPE_U64=y
CONFIG_FREERTOS_RUN_TIME_STATS_USING_ESP_TIMER=y
```

## firmware/sdkconfig.defaults.esp32p4
```kconfig
CONFIG_ESP32P4_SELECTS_REV_LESS_V3=y
CONFIG_ESP32P4_REV_MIN_100=y
CONFIG_ESPTOOLPY_NO_STUB=y
CONFIG_ESPTOOLPY_FLASHMODE_QIO=y
CONFIG_CACHE_L2_CACHE_256KB=y
CONFIG_SPI_FLASH_SUPPORT_BOYA_CHIP=y
CONFIG_ESP_DEFAULT_CPU_FREQ_MHZ_360=y
CONFIG_ESP_DEFAULT_CPU_FREQ_MHZ=360
CONFIG_SPIRAM_MODE_HEX=y
CONFIG_SPIRAM_SPEED_200M=y
CONFIG_LCD_DSI_ISR_CACHE_SAFE=y
CONFIG_LV_DRAW_BUF_ALIGN=64
CONFIG_LV_OBJ_STYLE_CACHE=y
# CONFIG_LV_USE_PPA is not set
CONFIG_LV_USE_FLOAT=y
```

## firmware/sdkconfig.defaults.guition-jc1060p470c
```kconfig
CONFIG_SIMCORE_FACTORY_BOARD_GUITION_JC1060P470C=y
CONFIG_TINYUSB_MODE_SLAVE=y
# CONFIG_TINYUSB_MODE_DMA is not set
CONFIG_TINYUSB_HID_COUNT=1
```

## firmware/sdkconfig.defaults.render-full
```kconfig
CONFIG_PITRIG_DISPLAY_RENDER_FULL=y
CONFIG_CACHE_L2_CACHE_512KB=y
CONFIG_CACHE_L2_CACHE_LINE_128B=y
```

## firmware/utils/pitrig_config/Kconfig
```kconfig
menu "Pitrig"

config PITRIG_DEBUG
    bool "Runtime performance diagnostics"
    default n
    select FREERTOS_GENERATE_RUN_TIME_STATS
    help
        Enables performance collection, transport diagnostics, and the
        on-screen performance overlay.

choice PITRIG_DEBUG_OVERLAY
    prompt "Debug on-screen overlay"
    depends on PITRIG_DEBUG
    default PITRIG_DEBUG_OVERLAY_FPS
    help
        What a debug build draws over the dashboard. The full panel blends a
        semi-transparent block over the widgets beneath it, which distorts
        frame measurements on small displays; the FPS figure is an opaque chip
        LVGL can draw without touching anything under it. Nothing leaves the
        dashboard exactly as a product build renders it.

config PITRIG_DEBUG_OVERLAY_FULL
    bool "Full statistics panel"

config PITRIG_DEBUG_OVERLAY_FPS
    bool "FPS figure only"

config PITRIG_DEBUG_OVERLAY_NONE
    bool "Nothing"

endchoice

config PITRIG_LOG_MODE_FULL
    bool "Formatted, level-aware log forwarding"
    default n
    help
        Selects the full ESP-IDF logging mode inside the logger instead of the
        simple one. The public logging API is identical either way; only which
        backend call the logger makes changes. See ADR 0001.

config PITRIG_LAYOUT_DEBUG
    bool "Dashboard layout outlines"
    default n
    help
        Draws dashboard block and widget boundaries.

choice PITRIG_DISPLAY_RENDER_MODE
    prompt "Display render mode"
    depends on PITRIG_FACTORY_BOARD_GUITION_JC1060P470C
    default PITRIG_DISPLAY_RENDER_FULL_STRIPS
    help
        How LVGL renders to the JC1060P470C panel. Full strips is the
        default: LVGL draws the damage into internal RAM, DMA carries it
        into the hidden frame buffer and the panel swaps at the frame
        boundary, so nothing tears at frame rates in partial's league.
        Partial blends the same strips straight into the buffer being
        scanned — the fastest measured steady state, and the one that
        accepts the one-frame seam ADR 0027 describes. Direct and full
        render into the panel's PSRAM frame buffers instead, tear-free at
        roughly half the frame rate. The RGB boards keep partial: their
        panel underruns when the processor blends into the scanning PSRAM
        buffer.

config PITRIG_DISPLAY_RENDER_PARTIAL
    bool "Partial strips (fastest, glyph seams)"

config PITRIG_DISPLAY_RENDER_DIRECT
    bool "Direct into panel buffers (tear-free, changed areas only)"

config PITRIG_DISPLAY_RENDER_FULL
    bool "Full-screen redraw into panel buffers (tear-free)"

config PITRIG_DISPLAY_RENDER_FULL_STRIPS
    bool "Full-screen redraw through internal strips (tear-free)"

endchoice

choice PITRIG_DISPLAY_COLOR_DEPTH
    prompt "Display colour depth"
    depends on PITRIG_FACTORY_BOARD_GUITION_JC1060P470C
    default PITRIG_DISPLAY_COLOR_16BIT
    help
        How many bits a pixel carries from LVGL to the JD9165 panel. 16-bit
        RGB565 is what the board ships with: two bytes a pixel through the
        render strips, the DMA copy, the panel frame buffers and the DSI
        link. 24-bit RGB888 spends three bytes a pixel in every one of them,
        so it asks half again as much of internal RAM, of external memory
        bandwidth and of the link, and returns the gradients RGB565 banding
        shows on a panel this size.

config PITRIG_DISPLAY_COLOR_16BIT
    bool "16-bit RGB565"

config PITRIG_DISPLAY_COLOR_24BIT
    bool "24-bit RGB888"

endchoice

choice PITRIG_DISPLAY_FRAME_START
    prompt "Frame start scheduling"
    depends on PITRIG_DISPLAY_RENDER_FULL_STRIPS
    default PITRIG_DISPLAY_FRAME_START_ON_CHANGE
    help
        When the LVGL pass that draws a frame is started. Both experiments
        live in the vendored display port's full-strips path and share the
        per-frame state it keeps there, so at most one of them can be
        selected. The default starts a frame as soon as telemetry changed
        something.

config PITRIG_DISPLAY_FRAME_START_ON_CHANGE
    bool "Start a frame as soon as telemetry changes something"

config PITRIG_DISPLAY_VSYNC_LOCK
    bool "Schedule each frame from the telemetry burst (experiment)"
    help
        Today a frame starts the moment telemetry arrives, and since the
        finished frame is held until the panel latches it and LVGL waits
        through that hold, the next burst is drawn only after the latch and
        shown a refresh later: on a screen that draws in 4 ms, a value is
        about 25 ms old when it appears. With this on, telemetry only writes
        the widgets; each burst of it arms one frame start a short allowance
        later, and the frame lands on the first latch it can make. When the
        previous frame has not latched yet and this one could still have
        made the next latch, the start is skipped - the feed is faster than
        the panel and one packet a second has to go anyway - which keeps
        the display one refresh closer to the data. A burst that comes too
        late for the next latch is drawn for the one after, consistently,
        and a screen whose frame fills the period starts at the latch as it
        does today. The allowance and the slack the decisions keep adapt to
        the measured jitter of the feed.

config PITRIG_DISPLAY_JIT
    bool "Start each frame as late as it can still meet the panel (experiment)"
    help
        Instead of drawing a frame as soon as something changed and then
        holding it until the panel is ready, sleep first and start drawing
        only when there is just enough time left to finish before the
        panel's next latch. The frame still lands exactly once per refresh,
        so the cadence is unchanged; what changes is that the values it
        draws are read as late as possible. The margin it keeps in hand
        adapts: a frame that misses its latch widens it, frames that hit
        narrow it back.

endchoice

config PITRIG_DISPLAY_UNCAPPED
    bool "Render without waiting for the panel (experiment)"
    depends on PITRIG_DISPLAY_RENDER_FULL_STRIPS
    default n
    help
        Drops the pacing wait that holds a finished frame until the panel is
        ready for it. The wait is what keeps every rendered frame on screen
        exactly once; without it the processor draws frames the panel never
        shows, which is wasted work and uneven motion. It exists to measure
        what the latency would be if the wait were not there, since on a
        screen reaching the panel rate that wait is the largest single term
        in it.

choice PITRIG_FACTORY_BOARD
    prompt "Factory board profile"
    default PITRIG_FACTORY_BOARD_GUITION_JC1060P470C if IDF_TARGET_ESP32P4
    default PITRIG_FACTORY_BOARD_T_DISPLAY_S3
    help
        Selects the immutable hardware identity and the fallback configuration
        used when neither NVS configuration slot is valid. A build links only
        the board drivers its target can carry, so the P4 offers one board and
        the ESP32-S3 keeps both of its alternatives discoverable — ESP-IDF
        resolves component requirements before loading this choice on a fresh
        configure.

config PITRIG_FACTORY_BOARD_T_DISPLAY_S3
    bool "LilyGO T-Display-S3"
    depends on IDF_TARGET_ESP32S3

config PITRIG_FACTORY_BOARD_GUITION_ESP32_4848S040
    bool "Guition ESP32-4848S040"
    depends on IDF_TARGET_ESP32S3

config PITRIG_FACTORY_BOARD_GUITION_JC1060P470C
    bool "Guition JC1060P470C"
    depends on IDF_TARGET_ESP32P4

config PITRIG_FACTORY_BOARD_ESP32S3_DEVKIT
    bool "Espressif ESP32-S3-DevKitC-1 (no display)"
    depends on IDF_TARGET_ESP32S3
    help
        Needs a 16 MB module with octal PSRAM (N16R8, N16R8V): the flash
        layout and partitions.csv reach 0x1000000, and the configuration
        buffers live in external RAM under the target-wide
        CONFIG_SPIRAM_MODE_OCT, so a module with less flash refuses to
        flash and one without octal PSRAM never reaches the recovery
        surface.

endchoice

endmenu
```
