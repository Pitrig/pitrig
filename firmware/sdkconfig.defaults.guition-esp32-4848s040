## firmware/sdkconfig.defaults.guition-esp32-4848s040
```kconfig
CONFIG_PITRIG_FACTORY_BOARD_GUITION_ESP32_4848S040=y
CONFIG_ESP32S3_DATA_CACHE_LINE_64B=y
CONFIG_LV_DRAW_SW_CIRCLE_CACHE_SIZE=16
CONFIG_LV_OBJ_STYLE_CACHE=y
CONFIG_SPIRAM_XIP_FROM_PSRAM=y
```
